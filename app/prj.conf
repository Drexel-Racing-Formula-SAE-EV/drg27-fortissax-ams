## CMakeLists.txt
```
cmake_minimum_required(VERSION 3.20.0)

get_filename_component(DRG27_AMS_ROOT "${CMAKE_CURRENT_SOURCE_DIR}/.." ABSOLUTE)
list(APPEND BOARD_ROOT "${DRG27_AMS_ROOT}")
list(APPEND DTS_ROOT "${DRG27_AMS_ROOT}")

find_package(Zephyr REQUIRED HINTS $ENV{ZEPHYR_BASE})
project(drg27_fortissax_ams)

target_sources(app PRIVATE
    src/main.c
    src/ams_safety.c
    src/ams_threads.c
)

target_include_directories(app PRIVATE
    "${DRG27_AMS_ROOT}/include"
)

# ---------------------------------------------------------------------------
# Z-006 portable AMS core
# ---------------------------------------------------------------------------
#
# Keep the portable core as ordinary CMake.  Its own CMakeLists.txt contains
# no Zephyr helpers and is reused verbatim by the true null-platform host gate.
# Platform integration points *toward* this core, never the reverse.
get_filename_component(
    AMS_CORE_DIR
    "${CMAKE_CURRENT_SOURCE_DIR}/../lib/ams_core"
    ABSOLUTE
)

add_subdirectory(
    "${AMS_CORE_DIR}"
    "${CMAKE_BINARY_DIR}/ams_core"
)

# drivers/ams is intentionally NOT added here.  This repository is a Zephyr
# module and zephyr/CMakeLists.txt creates ams_platform while Zephyr is still
# in kernel CMake mode.  Calling zephyr_library_named() from this application
# CMakeLists would happen too late (application mode) and is explicitly
# rejected by the architecture contract.
if(NOT TARGET ams_platform)
    message(FATAL_ERROR
        "ams_platform Zephyr module library was not created; "
        "check zephyr/module.yml and zephyr/CMakeLists.txt")
endif()

# The DER26 board CMakeLists is discovered and processed by Zephyr as part of
# board handling.  Never add the board directory manually from the app: doing
# so instantiates ams_board_safety twice and violates board-source ownership.
if(NOT TARGET ams_board_safety)
    message(FATAL_ERROR
        "ams_board_safety was not created by the DER26 board CMake integration")
endif()

# Platform adapters may consume portable AMS types/functions.  The portable
# core itself never receives a dependency back on the platform or Zephyr.
target_link_libraries(ams_platform PRIVATE ams_core)
target_link_libraries(app PRIVATE ams_core)
if(CONFIG_AMS_Z023_SUPERVISION_VALIDATION)
    target_sources(app PRIVATE src/ams_z023_safety.c)
endif()
```

## Kconfig
```
mainmenu "DRG27 Fortissax AMS"

source "Kconfig.zephyr"

menu "DRG27 AMS migration safety policy"

config AMS_BMS_AUTHORITY
    bool "Permit BMS_OK assertion authority"
    default n
    help
      Controls whether the application is allowed to contain BMS_OK
      assertion authority.

      This MUST remain disabled during the early Zephyr migration.
      Z-003 also enforces this with a C BUILD_ASSERT.

config AMS_BALANCE_AUTHORITY
    bool "Permit balancing authority"
    default n
    help
      Controls whether the application is allowed to command cell
      balancing.

      This MUST remain disabled during the early Zephyr migration.
      Z-003 also enforces this with a C BUILD_ASSERT.

config AMS_IMD_TARGET_VALIDATED
    bool "Claim physical IMD target validation"
    default n
    help
      Release-evidence gate corresponding to the v2.6.27
      AMS_IMD_TARGET_VALIDATED build gate. Z-013 must remain disabled:
      this stage proves source/SIL/target-build behavior only and does not
      claim physical PWM/status validation of the installed IMD.

config AMS_FAN_TARGET_VALIDATED
    bool "Claim physical fan PWM target validation"
    default n
    help
      Release-evidence gate for physical fan PWM validation. Z-013 must remain
      disabled until reset/pinctrl behavior, frequency, polarity and all six
      physical outputs have been verified on the installed target.


config AMS_CURRENT_ADC_PRIVATE_BACKEND
    bool
    default y
    select USE_STM32_LL_ADC
    select RESET
    help
      Private bounded STM32F767 ADC1/ADC2 polling backend for the dual-range
      current sensor. The generic Zephyr ADC subsystem intentionally does not
      own these ADC instances; this avoids an uncancellable async adc_context
      transaction and restores the v2.6.27 recover-after-timeout behavior.

config AMS_ADBMS_SPI_PRIVATE_BACKEND
    bool
    default y
    select USE_STM32_LL_SPI
    select RESET
    help
      Z-015 private STM32F767 SPI6 transport backend. The generic Zephyr SPI
      subsystem intentionally does not own SPI6. This hidden migration fact
      enables only the STM32 LL SPI module plus Zephyr reset-controller API.

config AMS_IWDG_VALIDATION_MODE
    bool "Arm STM32 IWDG for explicit Z-014 hardware validation"
    default n
    help
      Compile the Z-014 watchdog port in irreversible active mode. When this
      is disabled the adapter is still built and safely prepared, but
      wdt_setup() is never called and IWDG is not armed.

      Keep this disabled in the ordinary migration build. Enable only in the
      dedicated watchdog validation configuration while BMS and balancing
      authority remain disabled.

config AMS_WATCHDOG_TARGET_VALIDATED
    bool "Claim physical watchdog target validation"
    depends on AMS_IWDG_VALIDATION_MODE
    default n
    help
      Evidence gate only. Do not enable from a successful compile/link. This
      remains false until healthy feeding, deliberate starvation, supervisor
      death, process-fault non-reset, stack-margin and reset-cause tests have
      been demonstrated on the installed STM32F767 target.

config AMS_IWDG_STOP_FEED_TEST_AFTER_MS
    int "Validation-only automatic watchdog starvation delay (ms)"
    depends on AMS_IWDG_VALIDATION_MODE
    default 0
    range 0 600000
    help
      Zero disables automatic starvation. A nonzero value causes the safety
      supervisor to stop feeding after the requested runtime age so the real
      IWDG reset path can be measured. This option never grants authority.

config AMS_Z016_LINK_PROBE
    bool "Finite String B one-SMB read-only isoSPI probe"
    default n
    select CORTEX_M_SYSTICK_64BIT_CYCLE_COUNTER
    help
      Temporary ADBMS6822 evaluation-jumper path on PE4 only. No onboard
      String A fallback, configuration writes, conversion, S diagnostics,
      balancing, APM or vehicle authority. Stops on the first failed step.

config AMS_Z017_CELL_VALIDATION
    bool "String B one-SMB ADBMS6830 cell-acquisition validation"
    depends on !AMS_Z016_LINK_PROBE
    default n
    select CORTEX_M_SYSTICK_64BIT_CYCLE_COUNTER
    help
      No-authority Z017 acquisition profile. The priority-3 ADBMS owner uses
      String B / PE4 only, initializes one ADBMS6830B, runs startup POST, and
      acquires 15 C-authoritative cells plus advisory AVG8/IIR products. This
      does not grant BMS_OK, balancing, temperature, APM, estimator, or ADBMS
      watchdog safety authority.

config AMS_Z018_TEMP_VALIDATION
    bool "String B cell and 24-temperature validation"
    depends on !AMS_Z016_LINK_PROBE
    depends on !AMS_Z017_CELL_VALIDATION
    default n
    select CORTEX_M_SYSTICK_64BIT_CYCLE_COUNTER
    help
      Enables the three-mux temperature scan in the existing ADBMS owner.
      Temperature hardware is previously validated; Zephyr parity is pending.
      Acquisition grants no safety evidence or vehicle authority.

config AMS_Z019_RECOVERY_VALIDATION
    bool "Z019 protocol recovery over the Z018 acquisition profile"
    depends on AMS_Z018_TEMP_VALIDATION
    default n
    help
      Audit SID and safe configuration before acquisition. An interruption
      withdraws old epochs; one bounded remote reinitialization attempt may
      run on the next owner release. Failure latches until reboot.
      This grants no watchdog safety evidence or vehicle authority.

config AMS_Z018_AUX2_DIAGNOSTIC
    bool "Advisory AUX2 comparison"
    depends on AMS_Z018_TEMP_VALIDATION
    default n

config AMS_Z018_THERM_OW_DIAGNOSTIC
    bool "Advisory thermistor open-wire diagnostic"
    depends on AMS_Z018_TEMP_VALIDATION
    default n

config AMS_Z023_SUPERVISION_VALIDATION
    bool "Z023 shadow supervision and owner progress validation"
    depends on AMS_Z022_MEASUREMENT_VALIDATION
    default n
    help
      Copied fault supervision and owner progress; safety evidence remains off.

config AMS_Z022_MEASUREMENT_VALIDATION
    bool "Z022 single-SMB measurement publication validation"
    depends on AMS_Z020_BALANCE_DISABLED_VALIDATION
    default n
    help
      Enable current sampling and copied single-SMB measurement epochs.
      No full-pack estimator or safety evidence is claimed.

config AMS_Z020_BALANCE_DISABLED_VALIDATION
    bool "Z020 disabled balancing and diagnostic shadow validation"
    depends on AMS_Z019_RECOVERY_VALIDATION
    depends on !AMS_BALANCE_AUTHORITY && !AMS_BMS_AUTHORITY
    default n
    help
      Keep MUTE, zero DCC/timers/PWM and per-release Z019 audits.
      Publish an advisory shadow mask; no active balancing transport.

endmenu
menu "DRG27 AMS migration capabilities"

# Hidden migration facts.  These are intentionally not user-selectable: code
# presence, actor liveness, safety evidence, and physical validation are four
# different states and must never be inferred from one another.
config AMS_CAP_BMS_OK_PLATFORM_ADAPTER_PRESENT
    bool
    default y

config AMS_CAP_CURRENT_ADC_ADAPTER_PRESENT
    bool
    default y

config AMS_CAP_CURRENT_ACTOR_LIVE
    bool
    default y if AMS_Z022_MEASUREMENT_VALIDATION
    default n

config AMS_CAP_CURRENT_SAFETY_EVIDENCE
    bool
    default n

config AMS_CAP_ADBMS_SPI_ADAPTER_PRESENT
    bool
    default y

config AMS_CAP_ADBMS_SPI_PHYSICAL_VALIDATED
    bool
    default n

config AMS_CAP_ADBMS_ACTOR_LIVE
    bool
    default y if AMS_Z017_CELL_VALIDATION || AMS_Z018_TEMP_VALIDATION
    default n

config AMS_CAP_ADBMS_MONITOR_ACQUISITION_LIVE
    bool
    default y if AMS_Z017_CELL_VALIDATION || AMS_Z018_TEMP_VALIDATION
    default n

config AMS_CAP_ADBMS_SAFETY_EVIDENCE
    bool
    default n

config AMS_CAP_TEMPERATURE_ACQUISITION_LIVE
    bool
    default y if AMS_Z018_TEMP_VALIDATION
    default n

config AMS_CAP_TEMPERATURE_SAFETY_EVIDENCE
    bool
    default n

config AMS_CAP_CAN_ADAPTER_PRESENT
    bool
    default n

config AMS_CAP_CAN_ACTOR_LIVE
    bool
    default n

config AMS_CAP_CAN_SAFETY_EVIDENCE
    bool
    default n

config AMS_CAP_FAN_PWM_ADAPTER_PRESENT
    bool
    default y

config AMS_CAP_FAN_ACTOR_LIVE
    bool
    default y

config AMS_CAP_FAN_SAFETY_EVIDENCE
    bool
    default y

config AMS_CAP_FAN_PHYSICAL_VALIDATED
    bool
    default y if AMS_FAN_TARGET_VALIDATED
    default n

config AMS_CAP_IMD_CAPTURE_ADAPTER_PRESENT
    bool
    default y

config AMS_CAP_IMD_ACTOR_LIVE
    bool
    default y

config AMS_CAP_IMD_SAFETY_EVIDENCE
    bool
    default y

config AMS_CAP_IMD_PHYSICAL_VALIDATED
    bool
    default y if AMS_IMD_TARGET_VALIDATED
    default n

config AMS_CAP_WATCHDOG_ADAPTER_PRESENT
    bool
    default y

config AMS_CAP_WATCHDOG_ACTIVE
    bool
    default y if AMS_IWDG_VALIDATION_MODE
    default n

config AMS_CAP_WATCHDOG_PHYSICAL_VALIDATED
    bool
    default y if AMS_WATCHDOG_TARGET_VALIDATED
    default n

config AMS_CAP_WATCHDOG_FULL_ORACLE_COVERAGE
    bool
    default n

endmenu
```

## prj.conf
```kconfig
CONFIG_SERIAL=y
CONFIG_CONSOLE=y
CONFIG_UART_CONSOLE=y
CONFIG_PRINTK=y

CONFIG_GPIO=y

# ---------------------------------------------------------------------------
# Z-015 private bounded ADBMS SPI6 transport
# ---------------------------------------------------------------------------
# SPI6 is deliberately NOT owned by Zephyr's generic spi_stm32 driver. The
# hidden AMS_ADBMS_SPI_PRIVATE_BACKEND selects only STM32 LL SPI support and
# the reset-controller API used by the private polling/recovery backend.
CONFIG_SPI=n
CONFIG_SPI_ASYNC=n
CONFIG_SPI_RTIO=n
CONFIG_SPI_STM32_DMA=n
# Keep final-ELF caller evidence non-LTO so a real raw-transfer caller cannot
# disappear through cross-TU inlining/internalization.
CONFIG_LTO=n

CONFIG_ASSERT=y

# ---------------------------------------------------------------------------
# Z-003/Z-004 authority lock
# ---------------------------------------------------------------------------

CONFIG_AMS_BMS_AUTHORITY=n
CONFIG_AMS_BALANCE_AUTHORITY=n
CONFIG_AMS_IMD_TARGET_VALIDATED=n

# ---------------------------------------------------------------------------
# Z-004 static runtime diagnostics
# ---------------------------------------------------------------------------

CONFIG_THREAD_NAME=y
CONFIG_THREAD_STACK_INFO=y
CONFIG_INIT_STACKS=y

# No application heap is required by the AMS runtime skeleton.
CONFIG_HEAP_MEM_POOL_SIZE=0

# ---------------------------------------------------------------------------
# Z-011 current ADC adapter, hardened after the Z-015 HAL/driver audit
# ---------------------------------------------------------------------------
# ADC1/ADC2 are privately owned by the bounded STM32F767 polling backend.
# Keeping the generic driver out removes adc_context/IRQ/signal lifetime that
# cannot be safely cancelled after a conversion timeout.
CONFIG_ADC=n
CONFIG_ADC_ASYNC=n
CONFIG_ADC_STM32_DMA=n

# ---------------------------------------------------------------------------
# Z-012 fan PWM adapter
# ---------------------------------------------------------------------------

CONFIG_PWM=y

# ---------------------------------------------------------------------------
# Z-013 IMD PWM-input capture
# ---------------------------------------------------------------------------

CONFIG_PWM_CAPTURE=y


# ---------------------------------------------------------------------------
# Z-014 watchdog adapter (prepared in base build, armed only by validation cfg)
# ---------------------------------------------------------------------------

CONFIG_WATCHDOG=y
CONFIG_HWINFO=y
CONFIG_AMS_IWDG_VALIDATION_MODE=n
```

## z014_watchdog_starvation.conf
```kconfig
# Deliberate hardware-reset evidence image: after 10 s of normal runtime the
# safety supervisor stops feeding and the 5 s nominal IWDG must reset the MCU.
CONFIG_AMS_IWDG_VALIDATION_MODE=y
CONFIG_AMS_WATCHDOG_TARGET_VALIDATED=n
CONFIG_AMS_IWDG_STOP_FEED_TEST_AFTER_MS=10000
```

## z014_watchdog_validation.conf
```kconfig
# Explicit irreversible IWDG validation image. BMS/balance authority remains
# compile-time disabled by prj.conf and safety BUILD_ASSERTs.
CONFIG_AMS_IWDG_VALIDATION_MODE=y
CONFIG_AMS_WATCHDOG_TARGET_VALIDATED=n
CONFIG_AMS_IWDG_STOP_FEED_TEST_AFTER_MS=0
```

## z016_isospi_probe.conf
```kconfig
# Temporary 6822 eval jumper, String B/PE4, one SMB.
# This profile enables only a finite read-only link probe.
CONFIG_AMS_Z016_LINK_PROBE=y
```

## z017_cell_validation.conf
```kconfig
# Z-017 no-authority String-B / one-ADBMS6830 cell-acquisition profile.
CONFIG_AMS_Z017_CELL_VALIDATION=y
CONFIG_AMS_Z016_LINK_PROBE=n
CONFIG_AMS_BMS_AUTHORITY=n
CONFIG_AMS_BALANCE_AUTHORITY=n
CONFIG_AMS_IMD_TARGET_VALIDATED=n
CONFIG_AMS_FAN_TARGET_VALIDATED=n
CONFIG_AMS_WATCHDOG_TARGET_VALIDATED=n
```

## z018_aux2_validation.conf
```kconfig
# Z018: temperature scanning enabled; no vehicle authority.
CONFIG_AMS_Z018_TEMP_VALIDATION=y
CONFIG_AMS_Z017_CELL_VALIDATION=n
CONFIG_AMS_Z016_LINK_PROBE=n
CONFIG_AMS_Z018_AUX2_DIAGNOSTIC=y
CONFIG_AMS_Z018_THERM_OW_DIAGNOSTIC=n
CONFIG_AMS_BMS_AUTHORITY=n
CONFIG_AMS_BALANCE_AUTHORITY=n
```

## z018_temp_validation.conf
```kconfig
# Z018: temperature scanning enabled; no vehicle authority.
CONFIG_AMS_Z018_TEMP_VALIDATION=y
CONFIG_AMS_Z017_CELL_VALIDATION=n
CONFIG_AMS_Z016_LINK_PROBE=n
CONFIG_AMS_Z018_AUX2_DIAGNOSTIC=n
CONFIG_AMS_Z018_THERM_OW_DIAGNOSTIC=n
CONFIG_AMS_BMS_AUTHORITY=n
CONFIG_AMS_BALANCE_AUTHORITY=n
```

## src/main.c
```c
#include <zephyr/kernel.h>
#include <zephyr/sys/printk.h>

#include <ams_core/ams_core_contract.h>

#include "ams_safety.h"
#include "ams_threads.h"
#include <ams_platform/adbms_spi_lifecycle.h>
#include <ams_platform/current_adc.h>
#ifdef CONFIG_AMS_Z022_MEASUREMENT_VALIDATION
#include <ams_platform/measurement_pipeline.h>
#endif
#include <ams_platform/fan_pwm.h>
#include <ams_platform/imd_capture.h>


int main(void)
{
    int ret;

    ret = ams_safety_init();

    if (ret != 0) {
        printk("AMS safety init failed: %d\n", ret);
        k_panic();
    }

    ret = ams_core_contract_check();

    if (ret != 0) {
        printk("AMS portable core contract failed: %d\n", ret);
        k_panic();
    }

    printk("AMS portable core: contract PASS\n");

    /* Z-015 startup-only private SPI6 preparation. This validates the frozen
     * 108 MHz -> /256 -> 421875 Hz contract, configures PG13/PG12/PG14,
     * disables/clears the SPI6 NVIC path, and leaves PE2/PE4 inactive. It
     * performs no SPI transfer, CS-low pulse, wake operation or ADBMS command.
     * A preparation failure remains a fail-closed ADBMS transport/process
     * fault at this migration stage rather than manufacturing watchdog death. */
    ret = ams_adbms_spi_platform_init();
    {
        ams_adbms_spi_platform_status_t spi_status =
            ams_adbms_spi_platform_status();

        if (ret != 0) {
            printk("AMS ADBMS SPI6 adapter: FAULTED init=%d state=%u pclk=%u\n",
                   ret,
                   (unsigned int)spi_status.state,
                   (unsigned int)spi_status.input_clock_hz);
        } else {
            printk("AMS ADBMS SPI6 adapter: READY pclk=%u sck=%u timeout=%u "
                   "(%s)\n",
                   (unsigned int)spi_status.input_clock_hz,
                   (unsigned int)spi_status.achieved_clock_hz,
                   (unsigned int)spi_status.timeout_ms,
#ifdef CONFIG_AMS_Z016_LINK_PROBE
                   "finite String B probe enabled; startup performs no transfers"
#else
                   "no runtime transfers"
#endif
            );
        }
    }

    /* Keep the complete Z-011 adapter API in the target link without starting
     * a conversion. Live acquisition remains deferred to Z-022. */
    typedef int (*ams_current_adc_read_pair_fn_t)(ams_current_adc_pair_t *);
    typedef bool (*ams_current_adc_faulted_fn_t)(void);
    volatile ams_current_adc_read_pair_fn_t current_adc_read_anchor =
        ams_current_adc_read_pair;
    volatile ams_current_adc_faulted_fn_t current_adc_faulted_anchor =
        ams_current_adc_is_faulted;

    if ((current_adc_read_anchor == NULL) ||
        (current_adc_faulted_anchor == NULL)) {
        printk("AMS current ADC adapter link contract failed\n");
        k_panic();
    }

    ret = ams_current_adc_init();
    if (ret != 0) {
        printk("AMS current ADC adapter init failed: %d\n", ret);
        k_panic();
    }

#ifdef CONFIG_AMS_Z022_MEASUREMENT_VALIDATION
    printk("AMS current ADC adapter: READY (Z022 acquisition scheduled)\n");
#else
    printk("AMS current ADC adapter: READY (acquisition not scheduled)\n");
#endif

    /* Z-012: timer/PWM infrastructure failure is equivalent to the legacy
     * MX_TIMx_Init()/Error_Handler() fatal path. Per-channel startup command
     * failures remain soft fan process faults and are retried by the fan task. */
    ret = ams_fan_pwm_init();
    if (ret != 0) {
        printk("AMS fan PWM platform init failed: %d\n", ret);
        k_panic();
    }

    if (ams_fan_pwm_startup_fail_mask() != 0U) {
        printk("AMS fan PWM startup channel fault mask: 0x%02x\n",
               (unsigned int)ams_fan_pwm_startup_fail_mask());
    } else {
        printk("AMS fan PWM adapter: READY (all zones initialized off)\n");
    }
    printk("DRG27 Fortissax AMS - Zephyr Z-015 private SPI6 transport candidate\n");
    printk("BMS_OK: forced LOW\n");
    printk("BMS authority: DISABLED\n");
    printk("Balance authority: DISABLED\n");

    /*
     * Print the intended execution topology before it is started.
     */
    ams_threads_print_manifest();

#ifdef CONFIG_AMS_Z022_MEASUREMENT_VALIDATION
    if (!ams_z022_init()) { k_panic(); }
#endif
    ret = ams_threads_start();

    if (ret != 0) {
        printk("AMS runtime start failed: %d\n", ret);
        k_panic();
    }

    if (ams_imd_capture_started()) {
        printk("AMS IMD capture: ACTIVE (physical validation still pending)\n");
    } else {
        printk("AMS IMD capture: FAIL-CLOSED start error=%d\n",
               ams_imd_capture_start_error());
    }

    printk("AMS runtime threads: %u active / %u defined\n",
           (unsigned int)ams_threads_active_count(),
           (unsigned int)ams_threads_count());

    /*
     * Give the periodic workers time to produce useful first-cycle runtime
     * data before printing the initial diagnostics snapshot.
     */
    k_sleep(K_MSEC(250));

    struct ams_watchdog_runtime_snapshot watchdog_snapshot;
    if (ams_watchdog_runtime_snapshot_get(&watchdog_snapshot) == 0) {
        printk("AMS watchdog: runtime=%s platform_state=%u reason=%s coverage=%s\n",
               watchdog_snapshot.runtime_enabled ? "ACTIVE" : "PREPARED-NOT-ARMED",
               (unsigned int)watchdog_snapshot.platform_state,
               ams_watchdog_block_reason_str(watchdog_snapshot.block_reason),
               watchdog_snapshot.coverage_complete ? "FULL" : "PARTIAL");
    }

    ams_threads_request_diagnostics();

    /*
     * Main is startup-only.
     */
    for (;;) {
        k_sleep(K_FOREVER);
    }

    return 0;
}
```

## src/ams_safety.c
```c
#include "ams_safety.h"

#include <ams_platform/fail_low.h>
#include <ams_platform/bms_ok.h>

#include <stdint.h>

#include <zephyr/fatal.h>
#include <zephyr/sys/atomic.h>
#include <zephyr/sys/util.h>



/*
 * Migration authority invariant.
 *
 * Even if somebody accidentally changes prj.conf or menuconfig, the
 * migration image must refuse to compile rather than gain authority.
 */
BUILD_ASSERT(IS_ENABLED(CONFIG_BOARD_DER26_AMS),
             "AMS safety layer requires the DER26 AMS board");

BUILD_ASSERT(IS_ENABLED(CONFIG_SOC_STM32F767XX),
             "AMS safety layer requires STM32F767XX");

BUILD_ASSERT(!IS_ENABLED(CONFIG_AMS_BMS_AUTHORITY),
             "migration stage forbids BMS_OK assertion authority");

BUILD_ASSERT(!IS_ENABLED(CONFIG_AMS_BALANCE_AUTHORITY),
             "migration stage forbids balancing authority");

/*
 * RTOS integrity invariant.
 *
 * v2.6.27 used FreeRTOS configASSERT plus stack-overflow checking.  The
 * migration image keeps assertions enabled and raises the stack-overflow
 * protection level by requiring the Cortex-M MPU hardware guard.  The
 * application heap is also forbidden.  These are compile-time requirements,
 * not merely prj.conf preferences.
 */
BUILD_ASSERT(IS_ENABLED(CONFIG_ASSERT),
             "AMS migration requires kernel assertions");

BUILD_ASSERT(IS_ENABLED(CONFIG_ARM_MPU),
             "AMS migration requires the ARM MPU");

BUILD_ASSERT(IS_ENABLED(CONFIG_HW_STACK_PROTECTION),
             "AMS migration requires hardware stack protection");

BUILD_ASSERT(IS_ENABLED(CONFIG_THREAD_STACK_INFO),
             "AMS migration requires thread stack metadata");

BUILD_ASSERT(IS_ENABLED(CONFIG_INIT_STACKS),
             "AMS migration requires initialized stacks for proactive headroom queries");

BUILD_ASSERT(CONFIG_HEAP_MEM_POOL_SIZE == 0,
             "AMS migration must remain application-heap-free");



static atomic_t ams_panic_latched;

bool ams_safety_panic_latched(void)
{
    return atomic_get(&ams_panic_latched) != 0;
}

/*
 * Establish the normal Zephyr GPIO ownership once device initialization has
 * completed.
 *
 * The direct path is called first and again on every failure path.
 */
int ams_safety_init(void)
{
    /* Hardware ownership is delegated to the platform adapter.  The app safety
     * layer owns policy/fatal sequencing but not GPIO or Devicetree details. */
    return ams_bms_ok_platform_init_low();
}



/*
 * Zephyr fatal-policy override.
 *
 * Zephyr invokes this for fatal conditions such as CPU exceptions,
 * stack-check failures, kernel oopses, and kernel panics.
 *
 * Safety action happens BEFORE any attempt to halt the system.
 *
 * Do not add mutex, heap, workqueue, driver, or logging dependencies before
 * the direct fail-low call.
 */
void k_sys_fatal_error_handler(unsigned int reason,
                               const struct arch_esf *esf)
{
    ARG_UNUSED(esf);

    ams_bms_ok_force_low_direct();
    atomic_set(&ams_panic_latched, 1);

    k_fatal_halt(reason);
}
```

## src/ams_safety.h
```c
#ifndef DRG27_AMS_SAFETY_H_
#define DRG27_AMS_SAFETY_H_

#include <stdbool.h>

#ifdef __cplusplus
extern "C" {
#endif

/*
 * Configure the normal Zephyr GPIO path while preserving fail-low state.
 *
 * Returns 0 on success or a negative errno-style error.
 */
int ams_safety_init(void);

/* Latched before Zephyr fatal halt after the direct fail-low action. */
bool ams_safety_panic_latched(void);


#ifdef __cplusplus
}
#endif

#endif /* DRG27_AMS_SAFETY_H_ */
```

## src/ams_threads.h
```c
#ifndef DRG27_AMS_THREADS_H_
#define DRG27_AMS_THREADS_H_

#include <stdbool.h>
#include <stddef.h>
#include <stdint.h>

#include <ams_core/ams_imd.h>
#include <ams_core/ams_watchdog_policy.h>

#ifdef __cplusplus
extern "C" {
#endif

enum ams_thread_id {
    AMS_THREAD_SAFETY = 0,
    AMS_THREAD_CURRENT,
    AMS_THREAD_ADBMS,
    AMS_THREAD_CAN,
    AMS_THREAD_ESTIMATOR,
    AMS_THREAD_FAN,
    AMS_THREAD_AIR,
    AMS_THREAD_IMD,
    AMS_THREAD_DIAGNOSTICS,
    AMS_THREAD_COUNT
};

struct ams_imd_runtime_snapshot {
    uint32_t sequence;
    bool valid;
    bool ok;
    bool fault;
    ams_imd_status_t status;
    uint32_t duty_centipercent;
    uint32_t frequency_millihz;
    uint32_t last_valid_ms;
    uint32_t last_update_ms;
    bool capture_started;
    int capture_start_error;
    bool capture_callback_fault;
    uint32_t capture_callback_count;
    uint32_t capture_callback_error_count;
};

struct ams_watchdog_runtime_snapshot {
    uint32_t sequence;
    bool runtime_enabled;
    bool health_good;
    bool coverage_complete;
    bool stop_feed_test;

    uint16_t oracle_required_mask;
    uint16_t migration_evidence_mask;
    uint16_t effective_required_mask;
    uint16_t effective_stale_mask;

    uint16_t stack_warning_mask;
    uint16_t stack_critical_mask;
    uint16_t stack_query_error_mask;
    size_t min_stack_unused;

    ams_watchdog_block_reason_t block_reason;
    uint32_t feed_count;
    uint32_t block_count;
    uint32_t last_feed_ms;

    uint32_t platform_state;
    int platform_last_error;
    uint32_t platform_prepare_attempt_count;
    uint32_t platform_start_attempt_count;
    uint32_t platform_feed_success_count;
    uint32_t platform_feed_failure_count;

    bool reset_cause_valid;
    bool reset_was_watchdog;
    int reset_cause_error;
    int reset_cause_clear_error;
};

struct ams_thread_snapshot {
    const char *name;

    int priority;

    uint32_t period_ms;
    uint32_t stale_deadline_ms;
    uint32_t startup_grace_ms;

    bool enabled;
    bool safety_heartbeat_required;
    bool safety_evidence_ready;

    uint32_t heartbeat_seq;
    uint32_t heartbeat_age_ms;

    uint32_t scheduled_release_ms;
    uint32_t last_start_ms;
    uint32_t last_complete_ms;

    uint32_t last_lateness_ms;
    uint32_t max_lateness_ms;

    uint32_t release_miss_count;
    uint32_t overrun_count;

    uint32_t last_exec_us;
    uint32_t wcet_us;

    bool stale;
    bool startup_grace_active;

    size_t stack_size;
    size_t stack_configured_size;
    size_t stack_unused;
    size_t stack_used_high_water;
    size_t stack_warning_threshold;
    size_t stack_critical_threshold;
    bool stack_query_valid;
    bool stack_warning;
    bool stack_critical;
};

int ams_threads_start(void);

int ams_thread_snapshot_get(enum ams_thread_id id,
                            struct ams_thread_snapshot *snapshot);

int ams_imd_runtime_snapshot_get(struct ams_imd_runtime_snapshot *snapshot);
int ams_watchdog_runtime_snapshot_get(struct ams_watchdog_runtime_snapshot *snapshot);

void ams_threads_request_diagnostics(void);
void ams_threads_print_manifest(void);

size_t ams_threads_count(void);
size_t ams_threads_active_count(void);
uint32_t ams_threads_runtime_start_ms(void);

#ifdef __cplusplus
}
#endif

#endif /* DRG27_AMS_THREADS_H_ */
```

## src/ams_z023_safety.c
```c
#include "ams_z023_safety.h"
#include <ams_platform/supervision.h>
#include <ams_platform/fail_low.h>
void ams_z023_safety_cycle(void)
{
 ams_supervision_t decision;
 /* No output or watchdog authority is granted even when all records are good.
  * A rejected supervisor handoff also reinforces the physical inhibit. */
 if(!ams_z023_poll(&decision) || decision.inhibit)ams_bms_ok_force_low_direct();
}
```

## src/ams_z023_safety.h
```c
#ifndef AMS_Z023_SAFETY_H_
#define AMS_Z023_SAFETY_H_
/* Actual bounded Z023 workload called by the safety thread before feed policy. */
void ams_z023_safety_cycle(void);
#endif
```
