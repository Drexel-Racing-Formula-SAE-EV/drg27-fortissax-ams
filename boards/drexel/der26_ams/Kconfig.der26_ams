## boards/drexel/der26_ams/Kconfig.der26_ams
```kconfig
# SPDX-License-Identifier: Apache-2.0

config BOARD_DER26_AMS
    select SOC_STM32F767XX
```

## boards/drexel/der26_ams/board.yml
```yaml
board:
  name: der26_ams
  full_name: Drexel Racing DER26 Accumulator Management System
  vendor: others
  socs:
    - name: stm32f767xx
```

## dts/bindings/ams/drexel,ams-adbms-interface.yaml
```yaml
title: Drexel AMS private ADBMS SPI6 interface

description: |
  Board wiring and frozen transport contract for the DER26 ADBMS interface.
  The generic Zephyr SPI6 device remains disabled at Z-015: a private bounded
  polling backend owns SPI6 through STM32 LL while continuing to use Zephyr
  Devicetree, pinctrl, GPIO, clock-control, reset-controller and IRQ APIs.

  CS_A/CS_B are electrically meaningful to the ADBMS6822/isoSPI chain. Z-015
  initializes both inactive and performs no runtime transfer or wake pulse.

compatible: "drexel,ams-adbms-interface"

include:
  - base.yaml
  - pinctrl-device.yaml
  - reset-device.yaml

properties:
  spi-controller:
    type: phandle
    required: true
    description: Disabled SoC SPI6 node whose register/clock/IRQ metadata is privately owned.

  cs-a-gpios:
    type: phandle-array
    required: true
    description: Active-low chip select for ADBMS string A.

  cs-b-gpios:
    type: phandle-array
    required: true
    description: Active-low chip select for ADBMS string B.

  spi-input-clock-hz:
    type: int
    required: true
    const: 108000000
    description: Frozen expected APB2/SPI6 peripheral input clock.

  spi-prescaler:
    type: int
    required: true
    const: 256
    description: Frozen v2.6.27 SPI6 prescaler divisor.

  spi-frequency-hz:
    type: int
    required: true
    const: 421875
    description: Frozen achieved SPI6 serial clock, not merely a requested maximum.

  spi-timeout-ms:
    type: int
    required: true
    const: 500
    description: Frozen v2.6.27 SPI_TIMEOUT transport deadline.

  max-transfer-bytes:
    type: int
    required: true
    const: 512
    description: Frozen v2.6.27 BUFSZ bound for one logical transaction.

  read-dummy-byte:
    type: int
    required: true
    const: 255
    description: 0xFF clocking byte used after a read command prefix.
```

## dts/bindings/ams/drexel,ams-current-sense.yaml
```yaml
title: Drexel AMS private dual-range current-sense interface

description: |
  Board wiring and frozen ADC acquisition contract for the DER26 dual-range
  DHAB current sensor.  The generic Zephyr STM32 ADC devices remain disabled:
  a private bounded polling backend owns ADC1/ADC2 through STM32 LL while using
  Zephyr Devicetree, pinctrl, clock-control, reset-controller and IRQ APIs.

  ADC1 and ADC2 share the STM32F767 ADC common block reset and ADC_IRQn.  The
  private backend therefore owns the common ADC reset boundary and requires
  ADC3 to remain disabled as well.  Acquisition order is a frozen behavioral
  contract: high range first, then low range.

compatible: "drexel,ams-current-sense"

include:
  - base.yaml
  - pinctrl-device.yaml
  - reset-device.yaml

properties:
  high-controller:
    type: phandle
    required: true
    description: Disabled SoC ADC1 node used for register/clock/IRQ metadata.

  low-controller:
    type: phandle
    required: true
    description: Disabled SoC ADC2 node used for register/clock/IRQ metadata.

  high-channel:
    type: int
    required: true
    const: 3
    description: Frozen high-range input ADC1_IN3 / PA3.

  low-channel:
    type: int
    required: true
    const: 10
    description: Frozen low-range input ADC2_IN10 / PC0.

  adc-input-clock-hz:
    type: int
    required: true
    const: 108000000
    description: Frozen APB2 input clock feeding the ADC common prescaler.

  adc-prescaler:
    type: int
    required: true
    const: 6
    description: Frozen v2.6.27 synchronous PCLK2 divide-by-6 setting.

  adc-clock-hz:
    type: int
    required: true
    const: 18000000
    description: Frozen achieved ADC conversion clock after the /6 prescaler.

  resolution-bits:
    type: int
    required: true
    const: 12
    description: Frozen v2.6.27 ADC resolution.

  acquisition-ticks:
    type: int
    required: true
    const: 480
    description: Frozen v2.6.27 channel sampling time in ADC clock cycles.

  conversion-timeout-ms:
    type: int
    required: true
    const: 5
    description: Frozen v2.6.27 HAL_ADC_PollForConversion timeout argument.
```

## dts/bindings/ams/drexel,ams-fan-bank.yaml
```yaml
title: Drexel AMS six-zone cooling fan bank

description: |
  Six PWM outputs used by the AMS cooling fans. The pwms property supplies the
  Zephyr controller/channel/polarity description; the production adapter still
  uses cycle-exact pwm_set_cycles() to preserve the frozen v2.6.27 ARR/CCR
  behavior without nanosecond rounding.

compatible: "drexel,ams-fan-bank"

include: base.yaml

properties:
  pwms:
    type: phandle-array
    required: true
    description: Six fan PWM outputs in fan1 through fan6 order.

  pwm-names:
    type: string-array
    required: true
    const: ["fan1", "fan2", "fan3", "fan4", "fan5", "fan6"]
    description: Must contain fan1 through fan6.
```

## dts/bindings/ams/drexel,ams-imd.yaml
```yaml
title: Drexel AMS insulation monitoring device interface

description: |
  IMD M_HS PWM capture and independent OK_HS digital status input. The PWM
  period cell is descriptive consumer metadata only; capture timing is measured
  from the hardware counter and is not configured from that period value.

compatible: "drexel,ams-imd"

include: base.yaml

properties:
  pwms:
    type: phandle-array
    required: true
    description: PWM capture source for IMD M_HS.

  status-gpios:
    type: phandle-array
    required: true
    description: Active-high independent IMD OK_HS input.
```

## dts/bindings/ams/drexel,ams-safety-io.yaml
```yaml
title: Drexel AMS safety I/O

description: |
  Board-level safety I/O used by the AMS. The BMS_OK line is intentionally
  described in Devicetree even though the emergency fail-low implementation
  also owns a direct STM32 register path for pre-kernel and fatal handling.

compatible: "drexel,ams-safety-io"

include: base.yaml

properties:
  bms-ok-gpios:
    type: phandle-array
    required: true
    description: Active-high BMS_OK output. Physical inactive state is LOW.
```
